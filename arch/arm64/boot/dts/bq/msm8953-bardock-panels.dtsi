/*
 * Copyright (c) 2018, The LineageOS Project. All rights reserved.
 *
 * This program is free software; you can redistribute it and/or modify
 * it under the terms of the GNU General Public License version 2 and
 * only version 2 as published by the Free Software Foundation.
 *
 * This program is distributed in the hope that it will be useful,
 * but WITHOUT ANY WARRANTY; without even the implied warranty of
 * MERCHANTABILITY or FITNESS FOR A PARTICULAR PURPOSE.  See the
 * GNU General Public License for more details.
 */

#include "dsi-panel-ft8716-1080p-video.dtsi"
#include "dsi-panel-otm1906b-1080p-cmd.dtsi"

&dsi_ft8716_1080_vid {
	qcom,mdss-dsi-panel-timings-phy-v2 = [23 18 07 08 05 03 04 a0
		23 18 07 08 05 03 04 a0
		23 18 07 08 05 03 04 a0
		23 18 07 08 05 03 04 a0
		23 1e 07 08 05 03 04 a0];
};

&dsi_otm1906b_1080p_cmd {
	qcom,mdss-dsi-panel-timings-phy-v2 = [23 1e 08 09 05 03 04 a0
		23 1e 08 09 05 03 04 a0
		23 1e 08 09 05 03 04 a0
		23 1e 08 09 05 03 04 a0
		23 1a 08 09 05 03 04 a0];
};

&mdss_dsi0 {
	qcom,dsi-pref-prim-pan = <&dsi_ft8716_1080_vid>;
};
