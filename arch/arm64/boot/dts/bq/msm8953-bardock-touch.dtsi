&soc {
	i2c@78b7000 { /* BLSP1 QUP3 */
		status = "okay";
		focaltech@38{
			compatible = "focaltech,fts";
			reg = <0x38>;
			interrupt-parent = <&tlmm>;
			interrupts = <65 0x2>;
			/*vdd_ana-supply = <&vdd_vreg>;*/
			/*vdd-supply = <&pm8953_l10>;*/
			vcc_i2c-supply = <&pm8953_l6>;
			/* pins used by touchscreen */
			pinctrl-names = "pmx_ts_active","pmx_ts_suspend",
							"pmx_ts_release";
			pinctrl-0 = <&ts_int_active &ts_reset_active>;
			pinctrl-1 = <&ts_int_suspend &ts_reset_suspend>;
			pinctrl-2 = <&ts_release>;
			focaltech,name = "fts_ts";
			focaltech,family-id = <0x08>;
			focaltech,reset-gpio = <&tlmm 64 0x1>;
			focaltech,irq-gpio = <&tlmm 65 0x02>;
			focaltech,max-touch-number = <10>;
			focaltech,display-coords = <0 0 1080 1920>;
			focaltech,have-key;
			focaltech,key-number = <3>;
			focaltech,keys = <158 172 139>;
			focaltech,key-y-coord = <2000>;
			focaltech,key-x-coords = <200 600 800>;

		};
	};

	i2c@78b7000 { /* BLSP1 QUP3 */
		status = "ok";
		/*address-cells = <1>;*/
		/*size-cells = <0>;*/
		/*qcom,clk-freq-out = <400000>;*/
		ilitek@41{
			compatible = "ilitek,2120";
			reg = <0x41>;
			interrupt-parent = <&tlmm>;
			interrupts = <65 0x8>;
			ilitek,vci-gpio = <&tlmm 110 0x0>;
			vcc_i2c-supply = <&pm8953_l6>;
			vdd-supply = <&pm8953_l17>;
			ilitek,name = "ilitek_i2c";
			ilitek,reset-gpio = <&tlmm 64 0x00>;
			ilitek,irq-gpio = <&tlmm 65 0x00>;
			ilitek,vbus = "vcc_i2c";
			ilitek,vdd = "vdd";
		};
	};
};
